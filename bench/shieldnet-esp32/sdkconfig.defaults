## bench/shieldnet-wifi/main/Kconfig.projbuild
```kconfig
# Copyright (c) 2025-2026 BlackShield LDA
# SPDX-License-Identifier: Apache-2.0
menu "ShieldNet Wi-Fi benchmark"

    config SNBENCH_WIFI_SSID
        string "Wi-Fi SSID"
        default ""
        help
            The AP to join. Left empty the app will refuse to run.

    config SNBENCH_WIFI_PASSWORD
        string "Wi-Fi password"
        default ""
        help
            WPA2 password; empty means an open AP.

    config SNBENCH_PORT
        int "UDP port to listen on"
        default 32100

    config SNBENCH_PSK_HEX
        string "ShieldNet PSK (64 hex chars)"
        default "3333333333333333333333333333333333333333333333333333333333333333"
        help
            Must match the PSK the host-side driver uses.

endmenu
```

## bench/shieldnet-wifi/sdkconfig.defaults
```kconfig
# Copyright (c) 2025-2026 BlackShield LDA
# SPDX-License-Identifier: Apache-2.0
CONFIG_LOG_DEFAULT_LEVEL_INFO=y
CONFIG_COMPILER_OPTIMIZATION_PERF=y
CONFIG_ESP_MAIN_TASK_STACK_SIZE=32768
CONFIG_ESP_DEFAULT_CPU_FREQ_MHZ_240=y
CONFIG_ESP_DEFAULT_CPU_FREQ_MHZ=240
# Throughput settings: bigger lwIP buffers, no Wi-Fi power save.
CONFIG_LWIP_UDP_RECVMBOX_SIZE=64
CONFIG_ESP_WIFI_DYNAMIC_RX_BUFFER_NUM=64
CONFIG_ESP_WIFI_STATIC_RX_BUFFER_NUM=16
CONFIG_ESP_WIFI_TX_BUFFER_TYPE=1
CONFIG_ESP_WIFI_DYNAMIC_TX_BUFFER_NUM=64
CONFIG_ESP_TASK_WDT_TIMEOUT_S=60
```
